## main/Kconfig.projbuild
```kconfig
menu "BLEUART Configuration"

    config BLEUART_BAUD
        int "UART communication speed"
        range 1200 115200
        default 19200
        help
            UART communication speed.

    config BLEUART_DNAME
        string "Initial device name (dname)"
        default "bleuart"
        help
            BLE device name on first boot.

    config BLEUART_CNAME
        string "Initial location identifier (cname)"
        default "000000"
        help
            Unit identification string 

    config BLEUART_APPEARANCE
        hex "Appearance ID"
        range 0x0 0xffff
        default 0x0740
        help
            BLE appearance ID, default: Motorized device 0x0740

    config BLEUART_MID
        hex "BLE maufacturer ID"
        range 0x0 0xffff
        default 0xffff
        help
            Manufacturer ID for advanced BLE advertisement, default 0xffff

    config BLEUART_FOTA_URL
        string "FOTA URL"
        default ""
        help
            Firmware update base URL

    config BLEUART_FOTA_AGENT
        string "FOTA User agent"
        default "blueart/1.0"
        help
            User agent string sent with firwmare update request

endmenu
```

## sdkconfig.defaults
```kconfig
# SPDX-License-Identifier: MIT
#
# bleuart default configuration
#
# Assumes:
#
#   - target ESP32
#   - device ESP32-WROOM-32E (>=v3.1)
#
CONFIG_APP_REPRODUCIBLE_BUILD=y
CONFIG_BOOTLOADER_LOG_LEVEL_ERROR=y
CONFIG_SECURE_BOOT=y
CONFIG_SECURE_BOOT_V1_ENABLED=y
CONFIG_SECURE_BOOTLOADER_REFLASHABLE=y
CONFIG_ESPTOOLPY_FLASHSIZE_4MB=y
CONFIG_PARTITION_TABLE_TWO_OTA=y
CONFIG_PARTITION_TABLE_OFFSET=0x10000
CONFIG_COMPILER_OPTIMIZATION_SIZE=y
CONFIG_COMPILER_OPTIMIZATION_ASSERTIONS_DISABLE=y
CONFIG_COMPILER_OPTIMIZATION_CHECKS_SILENT=y
CONFIG_COMPILER_STACK_CHECK_MODE_NORM=y
CONFIG_BT_ENABLED=y
CONFIG_BT_NIMBLE_ENABLED=y
CONFIG_BT_NIMBLE_LOG_LEVEL_NONE=y
CONFIG_BT_NIMBLE_MAX_CONNECTIONS=1
CONFIG_BT_NIMBLE_MAX_BONDS=8
CONFIG_BT_NIMBLE_HOST_TASK_STACK_SIZE=5120
CONFIG_BT_NIMBLE_ROLE_CENTRAL=n
CONFIG_BT_NIMBLE_ROLE_BROADCASTER=n
CONFIG_BT_NIMBLE_ROLE_OBSERVER=n
CONFIG_BT_NIMBLE_NVS_PERSIST=y
CONFIG_BT_NIMBLE_SMP_ID_RESET=y
CONFIG_BT_NIMBLE_SM_LEGACY=n
CONFIG_BT_NIMBLE_SM_LVL=4
CONFIG_BT_NIMBLE_SM_SC_ONLY=1
CONFIG_BT_NIMBLE_PRINT_ERR_NAME=n
CONFIG_BT_NIMBLE_SVC_GAP_DEVICE_NAME=""
CONFIG_BT_NIMBLE_HOST_BASED_PRIVACY=y
CONFIG_BT_NIMBLE_ENABLE_CONN_REATTEMPT=y
CONFIG_BT_NIMBLE_PROX_SERVICE=n
CONFIG_BT_NIMBLE_ANS_SERVICE=n
CONFIG_BT_NIMBLE_CTS_SERVICE=n
CONFIG_BT_NIMBLE_HTP_SERVICE=n
CONFIG_BT_NIMBLE_IPSS_SERVICE=n
CONFIG_BT_NIMBLE_TPS_SERVICE=n
CONFIG_BT_NIMBLE_IAS_SERVICE=n
CONFIG_BT_NIMBLE_LLS_SERVICE=n
CONFIG_BT_NIMBLE_SPS_SERVICE=n
CONFIG_BT_NIMBLE_HR_SERVICE=n
CONFIG_BT_NIMBLE_BAS_SERVICE=n
CONFIG_BT_NIMBLE_DIS_SERVICE=n
CONFIG_BT_NIMBLE_SVC_GAP_GATT_SECURITY_LEVEL=y
CONFIG_BT_NIMBLE_SVC_GAP_RPA_ONLY=y
CONFIG_BTDM_CTRL_BLE_MAX_CONN=1
CONFIG_BTDM_CTRL_LPCLK_SEL_EXT_32K_XTAL=y
CONFIG_BTDM_BLE_DEFAULT_SCA_500PPM=y
CONFIG_BTDM_BLE_SCAN_DUPL=n
CONFIG_BTDM_CTRL_FULL_SCAN_SUPPORTED=n
CONFIG_BTDM_CTRL_CHECK_CONNECT_IND_ACCESS_ADDRESS=y
CONFIG_ESP_COEX_SW_COEXIST_ENABLE=n
CONFIG_ESP_ERR_TO_NAME_LOOKUP=n
CONFIG_SPI_MASTER_ISR_IN_IRAM=n
CONFIG_SPI_SLAVE_ISR_IN_IRAM=n
CONFIG_UART_ISR_IN_IRAM=y
CONFIG_ESP_GDBSTUB_SUPPORT_TASKS=n
CONFIG_ESP32_REV_MIN_3_1=y
CONFIG_ESP_SLEEP_POWER_DOWN_FLASH=y
CONFIG_RTC_CLK_SRC_EXT_CRYS=y
CONFIG_RTC_CLK_CAL_CYCLES=1024
CONFIG_ESP_NETIF_REPORT_DATA_TRAFFIC=n
CONFIG_ESP_PHY_CALIBRATION_AND_DATA_STORAGE=n
CONFIG_ESP_PHY_RF_CAL_FULL=y
CONFIG_PM_ENABLE=y
CONFIG_PM_DFS_INIT_AUTO=y
CONFIG_PM_SLP_DISABLE_GPIO=y
CONFIG_PM_LIGHTSLEEP_RTC_OSC_CAL_INTERVAL=64
CONFIG_RINGBUF_PLACE_FUNCTIONS_INTO_FLASH=y
CONFIG_ESP_DEFAULT_CPU_FREQ_MHZ_80=y
CONFIG_ESP_SYSTEM_PANIC_REBOOT_DELAY_SECONDS=5
CONFIG_ESP_MAIN_TASK_AFFINITY_NO_AFFINITY=y
CONFIG_ESP_INT_WDT_TIMEOUT_MS=2000
CONFIG_ESP_DEBUG_OCDAWARE=n
CONFIG_ESP32_DISABLE_BASIC_ROM_CONSOLE=y
CONFIG_ESP_WIFI_SOFTAP_SUPPORT=n
CONFIG_ESP_WIFI_ESPNOW_MAX_ENCRYPT_NUM=0
CONFIG_ESP_WIFI_ENTERPRISE_SUPPORT=n
CONFIG_FREERTOS_HZ=1000
CONFIG_FREERTOS_TIMER_SERVICE_TASK_NAME="timer"
CONFIG_FREERTOS_USE_TICKLESS_IDLE=y
CONFIG_FREERTOS_TLSP_DELETION_CALLBACKS=n
CONFIG_FREERTOS_INTERRUPT_BACKTRACE=n
CONFIG_FREERTOS_PLACE_FUNCTIONS_INTO_FLASH=y
CONFIG_HAL_ASSERTION_DISABLE=y
CONFIG_LOG_DEFAULT_LEVEL_NONE=y
CONFIG_LOG_DYNAMIC_LEVEL_CONTROL=n
CONFIG_LOG_TAG_LEVEL_IMPL_NONE=y
CONFIG_LWIP_LOCAL_HOSTNAME="bleuart"
CONFIG_LWIP_DNS_SUPPORT_MDNS_QUERIES=n
CONFIG_LWIP_IP4_REASSEMBLY=y
CONFIG_LWIP_IP6_REASSEMBLY=y
CONFIG_LWIP_DHCPS=n
CONFIG_LWIP_IPV6_AUTOCONFIG=y
CONFIG_LWIP_IPV6_RDNSS_MAX_DNS_SERVERS=1
CONFIG_LWIP_IPV6_DHCP6=y
CONFIG_LWIP_SNTP_MAX_SERVERS=3
CONFIG_LWIP_DHCP_GET_NTP_SRV=y
CONFIG_LWIP_FALLBACK_DNS_SERVER_SUPPORT=y
CONFIG_LWIP_FALLBACK_DNS_SERVER_ADDRESS="9.9.9.9"
CONFIG_MBEDTLS_CERTIFICATE_BUNDLE_DEFAULT_CMN=y
CONFIG_MBEDTLS_TLS_CLIENT_ONLY=y
CONFIG_MBEDTLS_KEY_EXCHANGE_RSA=n
CONFIG_MBEDTLS_CLIENT_SSL_SESSION_TICKETS=n
CONFIG_MBEDTLS_SERVER_SSL_SESSION_TICKETS=n
CONFIG_MBEDTLS_HKDF_C=y
CONFIG_MBEDTLS_ERROR_STRINGS=n
CONFIG_LIBC_LOCKS_PLACE_IN_IRAM=n
CONFIG_LIBC_NEWLIB_NANO_FORMAT=y
CONFIG_SPI_FLASH_ROM_DRIVER_PATCH=n
CONFIG_WS_TRANSPORT=n
CONFIG_VFS_SUPPORT_IO=n
```
